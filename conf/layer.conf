## conf/layer.conf
```bitbake
# Append conf dir to BBPATH
BBPATH .= ":${LAYERDIR}"

# Append recipe dir to BBFILES
BBFILES += "${LAYERDIR}/recipes*/*/*.bb ${LAYERDIR}/recipes*/*/*.bbappend"

BBFILE_COLLECTIONS += "rtlwifi"
BBFILE_PATTERN_rtlwifi = "^${LAYERDIR}/"
BBFILE_PRIORITY_rtlwifi = "1"

LAYERDEPENDS_rtlwifi = "core"
LAYERVERSION_rtlwifi = "1"
LAYERSERIES_COMPAT_rtlwifi = "kirkstone"
```
